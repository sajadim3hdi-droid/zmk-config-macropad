#include <behaviors.dtsi>
#include <dt-bindings/zmk/keys.h>

/ {
    keymap {
        compatible = "zmk,keymap";

        // Layer 0 — AutoCAD
        autocad_layer {
            display-name = "AutoCAD";
            bindings = <
                &mo 1           // SW1: switch to Revit layer
                &studio_unlock  // SW2: unlock for ZMK Studio
                &kp ESC         // SW3: Esc
            >;
            sensor-bindings = <
                &inc_dec_kp C_VOL_UP C_VOL_DN   // Encoder 1
                &inc_dec_kp C_NEXT C_PREV       // Encoder 2
                &inc_dec_kp PG_UP PG_DN         // Encoder 3
            >;
        };

        // Layer 1 — Revit
        revit_layer {
            display-name = "Revit";
            bindings = <
                &mo 0           // SW1: back to AutoCAD layer
                &studio_unlock  // SW2: unlock for ZMK Studio
                &kp ESC         // SW3: Esc
            >;
            sensor-bindings = <
                &inc_dec_kp UP DOWN             // Encoder 1
                &inc_dec_kp LEFT RIGHT          // Encoder 2
                &inc_dec_kp PG_UP PG_DN         // Encoder 3
            >;
        };
    };
};